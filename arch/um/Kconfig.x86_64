## arch/um/Kconfig.x86_64
```kconfig
config UML_X86
	def_bool y

config 64BIT
	def_bool y

#XXX: this is so in the underlying arch, but it's wrong!!!
config RWSEM_GENERIC_SPINLOCK
	def_bool y

config 3_LEVEL_PGTABLES
       def_bool y

config ARCH_HAS_SC_SIGNALS
	def_bool n

config ARCH_REUSE_HOST_VSYSCALL_AREA
	def_bool n

config SMP_BROKEN
	def_bool y

config GENERIC_FIND_FIRST_BIT
	def_bool y

config GENERIC_FIND_NEXT_BIT
	def_bool y

config GENERIC_HWEIGHT
	def_bool y

config ARCH_SUPPORTS_AOUT
	def_bool y
```

## arch/x86/perfmon/Kconfig
```kconfig
menu "Hardware Performance Monitoring support"
config PERFMON
	bool "Perfmon2 performance monitoring interface"
	select X86_LOCAL_APIC
	default n
	help
	Enables the perfmon2 interface to access the hardware
	performance counters. See <http://perfmon2.sf.net/> for
	more details.

config PERFMON_DEBUG
	bool "Perfmon debugging"
	default n
	depends on PERFMON
	help
	Enables perfmon debugging support

config  X86_PERFMON_INTEL_ARCH
	bool "Support for Intel architectural perfmon v1/v2/v3"
	depends on PERFMON
	default n
	help
	Enables support for Intel architectural performance counters.
	This feature was introduced with Intel Core Solo/Core Duo processors.
endmenu
```

## drivers/media/dvb/firewire/Kconfig
```kconfig
config DVB_FIREDTV
	tristate "FireDTV and FloppyDTV"
	depends on DVB_CORE && IEEE1394 && INPUT
	help
	  Support for DVB receivers from Digital Everywhere
	  which are connected via IEEE 1394 (FireWire).

	  These devices don't have an MPEG decoder built in,
	  so you need an external software decoder to watch TV.

	  To compile this driver as a module, say M here:
	  the module will be called firedtv.

if DVB_FIREDTV

config DVB_FIREDTV_IEEE1394
	def_bool IEEE1394

endif # DVB_FIREDTV
```

## drivers/media/video/cpia2/Kconfig
```kconfig
config VIDEO_CPIA2
	tristate "CPiA2 Video For Linux"
	depends on VIDEO_DEV && USB && VIDEO_V4L1
	select FW_LOADER
	---help---
	  This is the video4linux driver for cameras based on Vision's CPiA2
	  (Colour Processor Interface ASIC), such as the Digital Blue QX5
	  Microscope. If you have one of these cameras, say Y here

	  This driver is also available as a module (cpia2).

config VIDEO_CPIA2_FIRMWARE
	bool "Compile CPiA2 VP4 firmware into the kernel"
	depends on VIDEO_CPIA2
	---help---
	  This includes firmware for CPiA2 VP4 in the kernel image.
	  Say 'N' and let it get loaded from userspace on demand.
```

## drivers/mmc/core/Kconfig
```kconfig
#
# MMC core configuration
#

config MMC_UNSAFE_RESUME
	bool "Allow unsafe resume (DANGEROUS)"
	help
	  If you say Y here, the MMC layer will assume that all cards
	  stayed in their respective slots during the suspend. The
	  normal behaviour is to remove them at suspend and
	  redetecting them at resume. Breaking this assumption will
	  in most cases result in data corruption.

	  This option is usually just for embedded systems which use
	  a MMC/SD card for rootfs. Most people should say N here.

config MMC_PASSWORDS
	boolean "MMC card lock/unlock passwords (EXPERIMENTAL)"
	depends on EXPERIMENTAL
	select KEYS
	help
	  Say Y here to enable the use of passwords to lock and unlock
	  MMC cards.  This uses the access key retention support, using
	  request_key to look up the key associated with each card.

	  For example, if you have an MMC card that was locked using
	  Symbian OS on your cell phone, you won't be able to read it
	  on Linux without this support.
```

## drivers/scsi/osd/Kconfig
```kconfig
#
# Kernel configuration file for the OSD scsi protocol
#
# Copyright (C) 2008 Panasas Inc.  All rights reserved.
#
# Authors:
#   Boaz Harrosh <bharrosh@panasas.com>
#   Benny Halevy <bhalevy@panasas.com>
#
# This program is free software; you can redistribute it and/or modify
# it under the terms of the GNU General Public version 2 License as
# published by the Free Software Foundation
#
# FIXME: SCSI_OSD_INITIATOR should select CONFIG (HMAC) SHA1 somehow.
#        How is it done properly?
#

config SCSI_OSD_INITIATOR
	tristate "OSD-Initiator library"
	depends on SCSI
	help
		Enable the OSD-Initiator library (libosd.ko).
		NOTE: You must also select CRYPTO_SHA1 + CRYPTO_HMAC and their
		dependencies

config SCSI_OSD_ULD
	tristate "OSD Upper Level driver"
	depends on SCSI_OSD_INITIATOR
	help
		Build a SCSI upper layer driver that exports /dev/osdX devices
		to user-mode for testing and controlling OSD devices. It is also
		needed by osdfs, for mounting an OSD based file system.

config SCSI_OSD_DEBUG
	bool "Compile All OSD modules with lots of DEBUG prints"
	default n
	depends on SCSI_OSD_INITIATOR
	help
		OSD Code is populated with lots of OSD_DEBUG(..) printouts to
		dmesg. Enable this if you found a bug and you want to help us
		track the problem (see also MAINTAINERS).
```

## drivers/sfi/Kconfig
```kconfig
#
# SFI Configuration
#

menuconfig SFI
	bool "SFI (Simple Firmware Interface) Support"
	depends on X86
	---help---
	The Simple Firmware Interface (SFI) provides a lightweight method
	for platform firmware to pass information to the operating system
	via static tables in memory.

	For more information, see http://simplefirmware.org

	Say 'Y' here to enable the kernel to boot on SFI-only platforms.
```

## drivers/staging/asus_oled/Kconfig
```kconfig
config ASUS_OLED
	tristate "Asus OLED driver"
	depends on USB_SUPPORT
	default N
	---help---
	  Enable support for the OLED display present in some Asus laptops.
```

## drivers/staging/tuxguardian/Kconfig
```kconfig
config SECURITY_TUXGUARDIAN
	tristate "TuxGuardian network access control"
	depends on SECURITY_NETWORK && BROKEN
	default N
	---help---
	  Enable support for TuxGuardian, an access control that
	  attempts to provide control over every process that connects
	  to the network.
```

## drivers/usb/wusbcore/Kconfig
```kconfig
#
# Wireless USB Core configuration
#
config USB_WUSB
	bool "Enable Wireless USB extensions"
        select UWB
        select CRYPTO
        select CRYPTO_BLKCIPHER
        select CRYPTO_CBC
        select CRYPTO_MANAGER
        select CRYPTO_AES
	help
	  Enable the host-side support for Wireless USB.

          To compile this support select Y (built in). It is safe to
	  select even if you don't have the hardware.
```

## fs/ubifs/Kconfig
```kconfig
config UBIFS_FS
	tristate "UBIFS file system support"
	select CRC16
	select CRC32
	depends on MTD_UBI
	help
	  UBIFS is a file system for flash devices which works on top of UBI.

config UBIFS_COMPRESSION_OPTIONS
	bool "Advanced compression options for UBIFS"
	depends on UBIFS_FS
	default n
	help
	  This option allows to explicitly choose which compressions, if any,
	  are enabled in UBIFS. Removing compressors means inbility to read
	  existing file systems.

	  If unsure, say 'N'.

config UBIFS_LZO
	bool "UBIFS LZO compression support" if UBIFS_COMPRESSION_OPTIONS
	select CRYPTO_LZO
	depends on UBIFS_FS
	default y
	help
	   LZO compressor is generally faster then zlib but compresses worse.
	   Say 'Y' if unsure.

config UBIFS_ZLIB
	bool "UBIFS ZLIB compression support" if UBIFS_COMPRESSION_OPTIONS
	select CRYPTO_DEFLATE
	depends on UBIFS_FS
	default y
	help
	  Zlib copresses better then LZO but it is slower. Say 'Y' if unsure.

# Debugging-related stuff
source "fs/ubifs/Kconfig.debug"
```

## fs/ubifs/Kconfig.debug
```kconfig
# UBIFS debugging configuration options, part of fs/ubifs/Kconfig

config UBIFS_FS_DEBUG
	bool "Enable debugging"
	default n
	depends on UBIFS_FS
	select DEBUG_FS
	select KALLSYMS_ALL
	help
	  This option enables UBIFS debugging.

config UBIFS_FS_DEBUG_MSG_LVL
	int "Default message level (0 = no extra messages, 3 = lots)"
	depends on UBIFS_FS_DEBUG
	default "0"
	help
	  This controls the amount of debugging messages produced by UBIFS.
	  If reporting bugs, please try to have available a full dump of the
	  messages at level 1 while the misbehaviour was occurring. Level 2
	  may become necessary if level 1 messages were not enough to find the
	  bug. Generally Level 3 should be avoided.

config UBIFS_FS_DEBUG_CHKS
	bool "Enable extra checks"
	depends on UBIFS_FS_DEBUG
	help
	  If extra checks are enabled UBIFS will check the consistency of its
	  internal data structures during operation. However, UBIFS performance
	  is dramatically slower when this option is selected especially if the
	  file system is large.
```

## security/integrity/Kconfig
```kconfig
#
# Integrity configuration
#

config INTEGRITY
	bool "Enable different integrity models"
	help
	  This allows you to choose different integrity modules to be
	  configured into your kernel.

	  If you are unsure how to answer this question, answer N.

config INTEGRITY_AUDIT
	bool "Integrity audit boot parameter"
	depends on INTEGRITY
	default y
	help
	  This option adds a kernel parameter 'integrity_audit', which
	  allows integrity auditing to be disabled at boot.  If this
	  option is selected, integrity auditing can be disabled with
	  'integrity_audit=0' on the kernel command line.

source security/integrity/ima/Kconfig
```

## security/integrity/ima/Kconfig
```kconfig
#
# IBM Integrity Measurement Architecture
#

config IMA
	bool "Integrity Measurement Architecture(IMA)"
	depends on INTEGRITY
	depends on ACPI
	select CRYPTO
	select CRYPTO_HMAC
	select CRYPTO_MD5
	select CRYPTO_SHA1
	select TCG_TPM
	select TCG_TIS
	help
	  The Trusted Computing Group(TCG) runtime Integrity
	  Measurement Architecture(IMA) maintains a list of hash
	  values of executables and other sensitive system files
	  loaded into the run-time of this system.  If your system
	  has a TPM chip, then IMA also maintains an aggregate
	  integrity value over this list inside the TPM hardware.
	  These measurements and the aggregate (signed inside the
	  TPM) can be retrieved and presented to remote parties to
	  establish system properties. If unsure, say N.

config IMA_MEASURE_PCR_IDX
	int "PCR for Aggregate (8<= Index <= 14)"
	depends on IMA
	range 8 14
	default 10
	help
	  IMA_MEASURE_PCR_IDX determines the TPM PCR register index
	  that IMA uses to maintain the integrity aggregate of the
	  measurement list.  If unsure, use the default 10.

config IMA_BASE_HOOKS
	bool "IMA base hooks"
	depends on IMA
	default n
	help
	  Enable this option to allow the LSM module to enforce integrity.
```

## tests/Kconfig
```kconfig
# tests/Kconfig

menuconfig KERNEL_TESTS
	bool "Kernel subsystem tests"
	help
	  You can build kernel subsystem specific tests.

if KERNEL_TESTS

config DEBUG_LOCKING_API_SELFTESTS
	bool "Locking API boot-time self-tests"
	depends on DEBUG_KERNEL
	help
	  Say Y here if you want the kernel to run a short self-test during
	  bootup. The self-test checks whether common types of locking bugs
	  are detected by debugging mechanisms or not. (if you disable
	  lock debugging then those bugs wont be detected of course.)
	  The following locking APIs are covered: spinlocks, rwlocks,
	  mutexes and rwsems.

config RCU_TORTURE_TEST
	tristate "torture tests for RCU"
	depends on DEBUG_KERNEL
	default n
	help
	  This option provides a kernel module that runs torture tests
	  on the RCU infrastructure.  The kernel module may be built
	  after the fact on the running kernel to be tested, if desired.

	  Say Y here if you want RCU torture tests to be built into
	  the kernel.
	  Say M if you want the RCU torture tests to build as a module.
	  Say N if you are unsure.

config RCU_TORTURE_TEST_RUNNABLE
	bool "torture tests for RCU runnable by default"
	depends on RCU_TORTURE_TEST = y
	default n
	help
	  This option provides a way to build the RCU torture tests
	  directly into the kernel without them starting up at boot
	  time.  You can use /proc/sys/kernel/rcutorture_runnable
	  to manually override this setting.  This /proc file is
	  available only when the RCU torture tests have been built
	  into the kernel.

	  Say Y here if you want the RCU torture tests to start during
	  boot (you probably don't).
	  Say N here if you want the RCU torture tests to start only
	  after being manually enabled via /proc.

config RT_MUTEX_TESTER
	bool "Built-in scriptable tester for rt-mutexes"
	depends on DEBUG_KERNEL && RT_MUTEXES
	help
	  This option enables a rt-mutex tester.

config LKDTM
	tristate "Linux Kernel Dump Test Tool Module"
	depends on DEBUG_KERNEL
	depends on KPROBES
	depends on BLOCK
	default n
	help
	This module enables testing of the different dumping mechanisms by
	inducing system failures at predefined crash points.
	If you don't need it: say N
	Choose M here to compile this code as a module. The module will be
	called lkdtm.

	Documentation on how to use the module can be found in
	drivers/misc/lkdtm.c

endif # KERNEL_TESTS
```
